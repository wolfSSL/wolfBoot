/* unit-p1021-fcm-bytes.c
 *
 * Regression test for F-7975 and F-7976 in hal/nxp_p1021.c.
 *
 * F-7975: hal_flash_read_bytes() and hal_flash_write_bytes() loop on
 * `while (flash_idx < len)`, comparing the FCM buffer index (which
 * hal_flash_set_addr() initializes to the page column, `flash_idx = col`)
 * against the caller's relative byte count. With col != 0:
 *
 * - if len <= col the loop runs zero times, so the page program proceeds
 *   with stale FCM buffer contents (write) or the caller's buffer is left
 *   unchanged (read);
 * - if len > col only len - col bytes are copied;
 * - a final one-to-three byte remainder is copied as a full word, reading
 *   or writing outside the requested range.
 *
 * The fix computes an absolute end (flash_idx + len) and copies exactly
 * len bytes, handling the tail byte-wise.
 *
 * F-7976: the ext_flash_write()/ext_flash_read() page loops size every
 * iteration from the total request length instead of the remaining
 * length, do not cap it to the page, and program ELBC_FBCR with the
 * column offset - so the byte-count field (FBCR[BC], P1021RM 12.3.30
 * bits 20-31 MSB-first, i.e. the low 12 bits) carries the column rather
 * than a count: a nonsense transfer size whenever col is non-zero.
 * The fix uses chunk = min(len - pos, page_size - col), programs the BC
 * field (0 only for a full page from column 0 - the only
 * ECC-generating/checking setting) and advances by chunk.
 *
 * hal/nxp_p1021.c is PowerPC code, but the FCM helpers under test are
 * plain byte copies. The test includes the HAL file (via nxp_p1021_host.c,
 * generated by the Makefile) and drives the static helpers directly, with
 * flash_buf backed by a host array standing in for the eLBC FCM region.
 * The host copy differs from the real file only in that the three bare
 * `__asm__ __volatile__("..." )` cache-barrier statements (DDR init and
 * multi-core boot) are blanked out: they cannot assemble on x86. The
 * PowerPC-asm accessors from nxp_ppc.h are shadowed with host versions
 * below, so they are never emitted either.
 *
 * Copyright (C) 2026 wolfSSL Inc.
 *
 * This file is part of wolfBoot.
 *
 * wolfBoot is free software; you can redistribute it and/or modify
 * it under the terms of the GNU General Public License as published by
 * the Free Software Foundation; either version 3 of the License, or
 * (at your option) any later version.
 *
 * wolfBoot is distributed in the hope that it will be useful,
 * but WITHOUT ANY WARRANTY; without even the implied warranty of
 * MERCHANTABILITY or FITNESS FOR A PARTICULAR PURPOSE.  See the
 * GNU General Public License for more details.
 *
 * You should have received a copy of the GNU General Public License
 * along with this program; if not, write to the Free Software
 * Foundation, Inc., 51 Franklin Street, Fifth Floor, Boston, MA 02110-1335, USA
 */

#include <check.h>
#include <stdint.h>
#include <stdio.h>
#include <string.h>

#define TARGET_nxp_p1021

/* Back the CCSR register space with host memory so MMIO-style accesses
 * land somewhere harmless. */
static uint32_t g_ccsr_regs[0x200000 / sizeof(uint32_t)];

#include "nxp_ppc.h"

#undef CCSRBAR
#define CCSRBAR ((uintptr_t)g_ccsr_regs)

/* nxp_ppc.h's memory accessors and SPR helpers are PowerPC asm, which the
 * x86 backend cannot assemble when emitted. The FCM helpers under test
 * need only plain reads/writes, so shadow the asm versions with host
 * equivalents; the asm versions are never referenced from here on and so
 * are never emitted. (nxp_ppc.h is pre-included above, so the HAL's own
 * include of it is a no-op and its register macros expand against the
 * host-backed CCSRBAR.) */
#define get8(addr)  (*(const volatile uint8_t *)(addr))
#define set8(addr, v)  (*(volatile uint8_t *)(addr) = (uint8_t)(v))
#define get16(addr)  (*(const volatile uint16_t *)(addr))
#define set16(addr, v)  (*(volatile uint16_t *)(addr) = (uint16_t)(v))
#define get32(addr)  (*(const volatile uint32_t *)(addr))
/* set32 goes through a host hook so the F-7976 tests can log FBCR
 * writes and emulate the FCM<->NAND data move the hardware performs on
 * an LSOR write (see p1021_set32() below). */
static void p1021_set32(volatile uint32_t *addr, uint32_t v);
#define set32(addr, v) p1021_set32((addr), (uint32_t)(v))
#undef mtspr
#define mtspr(rn, v) ((void)0)
#undef mfspr
#define mfspr(rn) (0)
#undef mfmsr
#define mfmsr() (0)
#undef mtmsr
#define mtmsr(v) ((void)0)

/* PPC runtime symbols referenced by the emitted init code (normally
 * provided by boot_ppc.c / boot_ppc_start.S and the linker script);
 * never called by the tests. */
uint32_t _secondary_start_page;
uint32_t _second_half_boot_page;
uint32_t _bootpg_addr;
uint32_t _spin_table;
uint32_t _spin_table_addr;

unsigned long long get_ticks(void)
{
    return 0;
}
void wait_ticks(unsigned long long t)
{
    (void)t;
}
unsigned long get_pc(void)
{
    return 0;
}
void set_tlb(uint8_t tlb, uint8_t esel, uint32_t epn, uint32_t rpn,
        uint32_t urpn, uint8_t perms, uint8_t wimge, uint8_t ts,
        uint8_t tsize, uint8_t iprot)
{
    (void)tlb; (void)esel; (void)epn; (void)rpn; (void)urpn;
    (void)perms; (void)wimge; (void)ts; (void)tsize; (void)iprot;
}
void disable_tlb1(uint8_t esel)
{
    (void)esel;
}
void flush_cache(uint32_t start_addr, uint32_t size)
{
    (void)start_addr; (void)size;
}
void set_law(uint8_t idx, uint32_t addr_h, uint32_t addr_l,
        uint32_t trgt_id, uint32_t law_sz, int reset)
{
    (void)idx; (void)addr_h; (void)addr_l; (void)trgt_id; (void)law_sz;
    (void)reset;
}

/* Host stand-in for the eLBC FCM region (FLASH_BASE_ADDR): 8 1-KB FCM
 * buffers, hal_flash_set_addr() picks one per NAND page. */
static uint8_t g_fcm8k[8 * 1024];

#undef FLASH_BASE_ADDR
#define FLASH_BASE_ADDR ((uintptr_t)g_fcm8k)

/* Pull in the code under test (its statics become visible here).
 * nxp_p1021_host.c is generated from hal/nxp_p1021.c by the Makefile
 * (see there for the single mechanical difference). */
#include "nxp_p1021_host.c"

/* Stand-in FCM buffer for the F-7975 helper tests (they drive
 * flash_buf directly, without hal_flash_set_addr()). */
static uint8_t fcm[1024];

/* ---- F-7976: emulated NAND and FCM transfer hook ----
 *
 * The hardware moves data between the FCM buffer and the NAND page when
 * hal_flash_command() writes the LSOR register. On the host that write
 * is intercepted (p1021_set32) and the transfer is emulated from the
 * programmed registers, following P1021RM 12.3.30:
 *
 *   BC = FBCR & 0xFFF (RM bits 20-31, MSB-first);  BC == 0 -> the whole
 *   512-byte page (and spare) is transferred and FPAR[CI] is ignored,
 *   otherwise BC bytes are transferred starting at FPAR[CI].
 *
 * g_nand models 16 512-byte pages plus 64 spare bytes each. No bad
 * blocks: the spare bytes stay 0xFF, so the bad-page check in
 * ext_flash_read() does not trigger. */
static uint8_t g_nand[16 * (512 + 64)];
/* NAND byte at (page, col): each page is followed by 64 spare bytes. */
#define NAND(page, col) g_nand[(page) * (512 + 64) + (col)]
static uint32_t g_fbcr_log[16];
static int g_fbcr_n;

static void emulate_fcm_transfer(void)
{
    uint32_t fbar = *ELBC_FBAR;
    uint32_t fpar = *ELBC_FPAR;
    uint32_t fir  = *ELBC_FIR;
    uint32_t bc   = *ELBC_FBCR & 0xFFF;
    uint32_t page, ci;
    uint8_t *nand;
    volatile uint8_t *fcmw = (volatile uint8_t *)flash_buf;

    /* small-page decode (the test never builds the large-page variant):
     * FBAR = page >> 5, FPAR[14:10] = page within block, FPAR[9:0] = col */
    page = (fbar << 5) | ((fpar >> 10) & 0x1F);
    ci   = fpar & 0x1FF;
    if (bc == 0) {
        ci = 0;
        bc = 512;
    }
    if (ci + bc > 512) {
        bc = 512 - ci;
    }
    /* g_nand only models 16 pages. A page past the end means the code
     * under test walked off the emulated device (e.g. a spurious
     * bad-block skip): leave the FCM buffer alone rather than running
     * off the array, so the caller's data assertions report it. */
    if (page >= 16) {
        return;
    }
    nand = &g_nand[page * (512 + 64)];

    if (((fir >> 16) & 0xF) == ELBC_FIR_OP_RBW) {
        /* small-page read (RBW op in FIR slot 3): FCM <- NAND */
        memcpy((void *)(fcmw + ci), nand + ci, bc);
        if (ci == 0 && bc == 512) {
            /* a full-page read loads the spare region as well */
            memset((void *)(fcmw + 512), 0xFF, 64);
        }
    }
    else if (((fir >> 12) & 0xF) == ELBC_FIR_OP_WB) {
        /* small-page write (WB op in FIR slot 4): NAND <- FCM */
        memcpy(nand + ci, (const void *)(fcmw + ci), bc);
    }
}

static void p1021_set32(volatile uint32_t *addr, uint32_t v)
{
    *addr = v;

    if (addr == ELBC_LSOR) {
        emulate_fcm_transfer();
    }
    if (addr == ELBC_FBCR &&
        g_fbcr_n < (int)(sizeof(g_fbcr_log) / sizeof(g_fbcr_log[0]))) {
        g_fbcr_log[g_fbcr_n++] = v;
    }
}

static void setup(void)
{
    memset(fcm, 0x5A, sizeof(fcm));
    memset(g_fcm8k, 0xFF, sizeof(g_fcm8k)); /* erased FCM, 0xFF spares */
    memset(g_nand, 0xFF, sizeof(g_nand));
    flash_buf = (volatile uint8_t *)fcm;
    flash_idx = 0;
    g_fbcr_n = 0;
    set32(ELBC_LTESR, ELBC_LTESR_CC); /* FCM commands complete instantly */
}

static void teardown(void)
{
}

/* Fill a data buffer with a deterministic pattern. */
static void fill(uint8_t *buf, size_t len, uint8_t base)
{
    size_t i;

    for (i = 0; i < len; i++)
        buf[i] = (uint8_t)(base + i);
}

/* Column 0 still works: the whole request lands in the FCM buffer. */
START_TEST(test_write_col_zero)
{
    uint8_t data[64];

    fill(data, sizeof(data), 0x11);
    flash_idx = 0;

    hal_flash_write_bytes(data, sizeof(data));

    ck_assert_int_eq(memcmp(fcm, data, sizeof(data)), 0);
    ck_assert_uint_eq(fcm[64], 0x5A);
    ck_assert_uint_eq(flash_idx, 64);
}
END_TEST

/* The core F-7975 case: with col != 0 and len <= col the pre-fix loop
 * ran zero times and the page program went ahead with stale FCM
 * contents. All len bytes must land at FCM offset col. */
START_TEST(test_write_len_le_col)
{
    uint8_t data[50];

    fill(data, sizeof(data), 0x22);
    flash_idx = 100; /* hal_flash_set_addr(page, 100) */

    hal_flash_write_bytes(data, sizeof(data));

    ck_assert_int_eq(memcmp(fcm + 100, data, sizeof(data)), 0);
    ck_assert_uint_eq(fcm[99], 0x5A);
    ck_assert_uint_eq(fcm[150], 0x5A);
    ck_assert_uint_eq(flash_idx, 150);
}
END_TEST

/* col != 0 and len > col: exactly len bytes are copied, starting at col,
 * not len - col bytes as in the pre-fix loop. */
START_TEST(test_write_len_gt_col)
{
    uint8_t data[100];

    fill(data, sizeof(data), 0x33);
    flash_idx = 40;

    hal_flash_write_bytes(data, sizeof(data));

    ck_assert_int_eq(memcmp(fcm + 40, data, sizeof(data)), 0);
    ck_assert_uint_eq(fcm[39], 0x5A);
    ck_assert_uint_eq(fcm[140], 0x5A);
    ck_assert_uint_eq(flash_idx, 140);
}
END_TEST

/* A one-to-three byte tail must not be copied as a full word: the
 * pre-fix loop read/wrote a fourth byte past the requested range. */
START_TEST(test_write_tail_no_word_spill)
{
    uint8_t data[10];

    fill(data, sizeof(data), 0x44);
    flash_idx = 10; /* col not a word boundary either */

    hal_flash_write_bytes(data, sizeof(data));

    ck_assert_int_eq(memcmp(fcm + 10, data, sizeof(data)), 0);
    ck_assert_uint_eq(fcm[20], 0x5A);
    ck_assert_uint_eq(fcm[21], 0x5A);
    ck_assert_uint_eq(flash_idx, 20);
}
END_TEST

/* Column-0 read with a short tail: exactly len bytes out, no word spill. */
START_TEST(test_read_col_zero_tail)
{
    uint8_t data[10];
    size_t i;

    for (i = 0; i < 16; i++)
        fcm[i] = (uint8_t)(0x50 + i);
    memset(data, 0x00, sizeof(data));
    flash_idx = 0;

    hal_flash_read_bytes(data, sizeof(data));

    for (i = 0; i < sizeof(data); i++)
        ck_assert_uint_eq(data[i], fcm[i]);
    ck_assert_uint_eq(fcm[10], 0x5A); /* untouched */
    ck_assert_uint_eq(flash_idx, 10);
}
END_TEST

/* Read with col != 0 and len <= col: the pre-fix loop ran zero times and
 * left the caller's buffer unchanged. */
START_TEST(test_read_len_le_col)
{
    uint8_t data[20];
    size_t i;

    for (i = 0; i < 20; i++)
        fcm[100 + i] = (uint8_t)(0x70 + i);
    memset(data, 0x00, sizeof(data));
    flash_idx = 100;

    hal_flash_read_bytes(data, sizeof(data));

    ck_assert_int_eq(memcmp(data, fcm + 100, sizeof(data)), 0);
    ck_assert_uint_eq(flash_idx, 120);
}
END_TEST

/* Read with col != 0 and len > col: exactly len bytes out. */
START_TEST(test_read_len_gt_col)
{
    uint8_t data[60];
    size_t i;

    for (i = 0; i < 64; i++)
        fcm[48 + i] = (uint8_t)(0x80 + i);
    memset(data, 0x00, sizeof(data));
    flash_idx = 48;

    hal_flash_read_bytes(data, sizeof(data));

    ck_assert_int_eq(memcmp(data, fcm + 48, sizeof(data)), 0);
    ck_assert_uint_eq(flash_idx, 108);
}
END_TEST

/* ---- F-7976: ext_flash_write()/ext_flash_read() page loops ---- */

/* A full-page write from column 0 must keep BC = 0 (full page + spare,
 * the only ECC-generating setting). */
START_TEST(test_p1021_write_full_page)
{
    uint8_t data[2 * 1024];
    size_t i;

    fill(data, sizeof(data), 0x10);

    ck_assert_int_eq(ext_flash_write(0, data, 512), 0);

    ck_assert_int_eq(g_fbcr_n, 1);
    ck_assert_uint_eq(g_fbcr_log[0], 0);
    for (i = 0; i < 512; i++)
        ck_assert_uint_eq(g_nand[i], data[i]);
}
END_TEST

/* A partial write must program the byte count into FBCR[BC] (the
 * pre-fix code wrote the column into the reserved bits 0-19). With a
 * stale FCM buffer the pre-fix full-page transfer also clobbered the
 * page columns outside the request. */
START_TEST(test_p1021_write_partial)
{
    uint8_t data[1024];
    size_t i;

    memset(g_fcm8k, 0x5A, 1024); /* stale FCM buffer 0 */
    fill(data, sizeof(data), 0x20);

    ck_assert_int_eq(ext_flash_write(100, data, 400), 0);

    ck_assert_int_eq(g_fbcr_n, 1);
    ck_assert_uint_eq(g_fbcr_log[0], 400u);
    for (i = 0; i < 400; i++)
        ck_assert_uint_eq(g_nand[100 + i], data[i]);
    for (i = 0; i < 100; i++)
        ck_assert_uint_eq(g_nand[i], 0xFF);
    for (i = 500; i < 512; i++)
        ck_assert_uint_eq(g_nand[i], 0xFF);
}
END_TEST

/* Multi-page write: each iteration must use the remaining length.
 * Pre-fix, the second page transfer was sized from the total length,
 * reading 424 bytes past the request and programming them to flash. */
START_TEST(test_p1021_write_multipart)
{
    uint8_t data[2 * 1024];
    size_t i;

    fill(data, sizeof(data), 0x30);

    ck_assert_int_eq(ext_flash_write(0, data, 600), 0);

    ck_assert_int_eq(g_fbcr_n, 2);
    ck_assert_uint_eq(g_fbcr_log[0], 0);        /* page 0: full, BC = 0 */
    ck_assert_uint_eq(g_fbcr_log[1], 88u);
    for (i = 0; i < 512; i++)
        ck_assert_uint_eq(g_nand[i], data[i]);
    for (i = 0; i < 88; i++)
        ck_assert_uint_eq(NAND(1, i), data[512 + i]);
    for (i = 88; i < 512; i++)
        ck_assert_uint_eq(NAND(1, i), 0xFF);
}
END_TEST

/* Unaligned start: the first chunk is capped at the page end and the
 * loop must continue on the next page with the true remaining length. */
START_TEST(test_p1021_write_unaligned)
{
    uint8_t data[2 * 1024];
    size_t i;

    fill(data, sizeof(data), 0x40);

    ck_assert_int_eq(ext_flash_write(100, data, 600), 0);

    ck_assert_int_eq(g_fbcr_n, 2);
    ck_assert_uint_eq(g_fbcr_log[0], 412u);
    ck_assert_uint_eq(g_fbcr_log[1], 188u);
    for (i = 0; i < 412; i++)
        ck_assert_uint_eq(g_nand[100 + i], data[i]);
    for (i = 0; i < 100; i++)
        ck_assert_uint_eq(g_nand[i], 0xFF);
    for (i = 412; i < 600; i++)
        ck_assert_uint_eq(NAND(1, i - 412), data[i]);
    for (i = 188; i < 512; i++)
        ck_assert_uint_eq(NAND(1, i), 0xFF);
}
END_TEST

/* A full-page read from column 0 must keep BC = 0 (full page + spare,
 * the only ECC-checking setting). */
START_TEST(test_p1021_read_full_page)
{
    uint8_t data[2 * 1024];
    size_t i;

    for (i = 0; i < 512; i++)
        g_nand[i] = (uint8_t)(0x50 + i);

    ck_assert_int_eq(ext_flash_read(0, data, 512), 512);

    ck_assert_int_eq(g_fbcr_n, 1);
    ck_assert_uint_eq(g_fbcr_log[0], 0);
    for (i = 0; i < 512; i++)
        ck_assert_uint_eq(data[i], g_nand[i]);
}
END_TEST

/* A short read must still transfer the spare region, because the
 * bad-block marker lives there. With BC != 0 the FCM only loads the
 * requested main-area bytes and flash_buf[bad_marker] is leftover FCM
 * RAM from an earlier operation: a stale non-0xFF byte then makes
 * ext_flash_read() declare the block bad, skip to the next erase block
 * and return data from the wrong address -- while still returning len.
 * Here FCM buffer 0's marker byte is dirtied before the read. */
START_TEST(test_p1021_read_short_spare_loaded)
{
    uint8_t data[16];
    size_t i;

    for (i = 0; i < 512; i++)
        g_nand[i] = (uint8_t)(0x80 + i);
    /* small page: bad marker at page_size + 5 in FCM buffer 0 */
    g_fcm8k[512 + 5] = 0x00;
    memset(data, 0xEE, sizeof(data));

    ck_assert_int_eq(ext_flash_read(0, data, 4), 4);

    ck_assert_int_eq(g_fbcr_n, 1);
    ck_assert_uint_eq(g_fbcr_log[0], 0);
    for (i = 0; i < 4; i++)
        ck_assert_uint_eq(data[i], g_nand[i]);
    for (i = 4; i < sizeof(data); i++)
        ck_assert_uint_eq(data[i], 0xEE);
}
END_TEST

/* Multi-page read: the second iteration must copy only the remaining
 * 88 bytes. Pre-fix it copied a full page, writing 424 bytes past the
 * caller's buffer. */
START_TEST(test_p1021_read_multipart)
{
    uint8_t data[2 * 1024];
    size_t i;

    for (i = 0; i < 512; i++)
        g_nand[i] = (uint8_t)(0x60 + i);
    for (i = 0; i < 512; i++)
        NAND(1, i) = (uint8_t)(0x70 + i);
    memset(data, 0xEE, sizeof(data));

    ck_assert_int_eq(ext_flash_read(0, data, 600), 600);

    ck_assert_int_eq(g_fbcr_n, 2);
    /* reads always transfer the full page + spare (BC = 0); read_size
     * only bounds how much is copied out of the FCM buffer */
    ck_assert_uint_eq(g_fbcr_log[0], 0);
    ck_assert_uint_eq(g_fbcr_log[1], 0);
    for (i = 0; i < 512; i++)
        ck_assert_uint_eq(data[i], g_nand[i]);
    for (i = 0; i < 88; i++)
        ck_assert_uint_eq(data[512 + i], NAND(1, i));
    for (i = 600; i < sizeof(data); i++)
        ck_assert_uint_eq(data[i], 0xEE);
}
END_TEST

Suite *p1021_fcm_suite(void)
{
    Suite *s = suite_create("p1021-fcm-bytes");
    TCase *tc = tcase_create("p1021-fcm-bytes");

    tcase_add_checked_fixture(tc, setup, teardown);
    tcase_add_test(tc, test_write_col_zero);
    tcase_add_test(tc, test_write_len_le_col);
    tcase_add_test(tc, test_write_len_gt_col);
    tcase_add_test(tc, test_write_tail_no_word_spill);
    tcase_add_test(tc, test_read_col_zero_tail);
    tcase_add_test(tc, test_read_len_le_col);
    tcase_add_test(tc, test_read_len_gt_col);
    tcase_add_test(tc, test_p1021_write_full_page);
    tcase_add_test(tc, test_p1021_write_partial);
    tcase_add_test(tc, test_p1021_write_multipart);
    tcase_add_test(tc, test_p1021_write_unaligned);
    tcase_add_test(tc, test_p1021_read_full_page);
    tcase_add_test(tc, test_p1021_read_short_spare_loaded);
    tcase_add_test(tc, test_p1021_read_multipart);

    suite_add_tcase(s, tc);
    return s;
}

int main(void)
{
    int fails;
    Suite *s = p1021_fcm_suite();
    SRunner *sr = srunner_create(s);

    srunner_run_all(sr, CK_NORMAL);
    fails = srunner_ntests_failed(sr);
    srunner_free(sr);

    return fails;
}
