/* unit-t2080-fman-loader.c
 *
 * Regression test: hal_fman_init() in hal/nxp_t2080.c checked only the
 * NOR window guard and the QEF magic, then copied microcode words into
 * FMan instruction RAM and marked the engine ready. With no version,
 * count, length or code-offset validation, a valid-looking blob with an
 * out-of-image offset copied arbitrary memory into IRAM, and a count of
 * zero counted as a successful upload of nothing.
 *
 * Extracts the qe_* structures and hal_fman_init() (generated by the
 * Makefile) and runs them against a test-owned NOR image, with the FMAN
 * slot at a nonzero bank offset so the extent check is exercised.
 * Copyright (C) 2026 wolfSSL Inc.
 *
 * This file is part of wolfBoot.
 *
 * wolfBoot is free software; you can redistribute it and/or modify
 * it under the terms of the GNU General Public License as published by
 * the Free Software Foundation; either version 3 of the License, or
 * (at your option) any later version.
 *
 * wolfBoot is distributed in the hope that it will be useful,
 * but WITHOUT ANY WARRANTY; without even the implied warranty of
 * MERCHANTABILITY or FITNESS FOR A PARTICULAR PURPOSE.  See the
 * GNU General Public License for more details.
 *
 * You should have received a copy of the GNU General Public License
 * along with this program; if not, write to the Free Software
 * Foundation, Inc., 51 Franklin Street, Fifth Floor, Boston, MA 02110-1335, USA
 */

#include <check.h>
#include <stdint.h>
#include <string.h>

/* Emulated NOR: a 4 MiB bank with the FMAN slot 512 KiB in, leaving
 * 0x380000 of extent after it for the extent check to bite. The array
 * carries 1 MiB of guard slack after the bank so a pre-fix loader
 * (which honors no extent) reading past the bank stays in-bounds on
 * the host and fails the assertions instead of segfaulting. */
#define NOR_BANK_SIZE 0x400000
#define NOR_SIZE (NOR_BANK_SIZE + 0x100000)
#define FMAN_SLOT_OFFSET 0x80000
static uint8_t g_nor[NOR_SIZE];

#define FLASH_BASE_ADDR ((uintptr_t)g_nor)
#define FLASH_BANK_SIZE ((uintptr_t)NOR_BANK_SIZE)
#define FMAN_FW_ADDR ((uintptr_t)(g_nor + FMAN_SLOT_OFFSET))

/* Emulated FMan IRAM: a word array plus the address pointer, so a read
 * of IDATA returns the IRAM word at the current pointer, like the
 * hardware (the loader resets the pointer to 0 and reads code[0] back
 * to verify the upload). */
#define FMAN_IRAM_WORDS 256
static uint32_t g_fman_iram[FMAN_IRAM_WORDS];
static int g_fman_idx;
static int g_fman_auto;
static uint32_t g_fman_ready;

#define FMAN_IRAM_IADD   ((volatile uint32_t *)&g_fman_regs[0])
#define FMAN_IRAM_IDATA  ((volatile uint32_t *)&g_fman_regs[1])
#define FMAN_IRAM_IREADY ((volatile uint32_t *)&g_fman_regs[3])
#define FMAN_IRAM_IADD_AIE 0x80000000
#define FMAN_IRAM_READY 0x80000000

static uint32_t g_fman_regs[8];

static void fman_set32(uint32_t addr, uint32_t v)
{
    if (addr == (uint32_t)(uintptr_t)FMAN_IRAM_IADD) {
        g_fman_auto = (v & FMAN_IRAM_IADD_AIE) != 0;
        g_fman_idx = (int)((v & ~FMAN_IRAM_IADD_AIE) / 4);
    }
    else if (addr == (uint32_t)(uintptr_t)FMAN_IRAM_IDATA) {
        if (g_fman_idx < FMAN_IRAM_WORDS)
            g_fman_iram[g_fman_idx] = v;
        if (g_fman_auto)
            g_fman_idx++;
    }
    else if (addr == (uint32_t)(uintptr_t)FMAN_IRAM_IREADY) {
        g_fman_ready = v;
    }
}

static uint32_t fman_get32(uint32_t addr)
{
    if (addr == (uint32_t)(uintptr_t)FMAN_IRAM_IDATA)
        return g_fman_idx < FMAN_IRAM_WORDS ? g_fman_iram[g_fman_idx] : 0;
    if (addr == (uint32_t)(uintptr_t)FMAN_IRAM_IREADY)
        return g_fman_ready;
    return 0;
}

#define set32(addr, v) fman_set32((uint32_t)(uintptr_t)(addr), (uint32_t)(v))
#define get32(addr) fman_get32((uint32_t)(uintptr_t)(addr))

int wolfBoot_printf(const char *fmt, ...)
{
    (void)fmt;
    return 0;
}

/* The real qe_* structures and hal_fman_init() from hal/nxp_t2080.c
 * (extracted by the Makefile). */
#include "t2080_fman_extract.h"

static struct qe_firmware *slot(void)
{
    return (struct qe_firmware *)(g_nor + FMAN_SLOT_OFFSET);
}

/* Build a self-consistent blob in the FMAN slot: one microcode with
 * code_words words at code_offset, trailing CRC slot. Returns the
 * declared length. */
static uint32_t make_blob(uint32_t code_offset, uint32_t code_words,
    uint32_t version, uint8_t count)
{
    struct qe_firmware *fw = slot();
    uint64_t calc = sizeof(struct qe_firmware) +
        (uint64_t)(count ? count - 1 : 0) * sizeof(struct qe_microcode);
    uint32_t i;

    memset(g_nor, 0x00, sizeof(g_nor));
    fw->header.magic[0] = 'Q';
    fw->header.magic[1] = 'E';
    fw->header.magic[2] = 'F';
    fw->header.version = version;
    fw->count = count;
    if (count >= 1) {
        fw->microcode[0].count = code_words;
        fw->microcode[0].code_offset = code_offset;
        strncpy((char *)fw->microcode[0].id, "test-fman", 31);
    }
    calc += (uint64_t)4 * code_words;

    if (code_offset + 4 * code_words <= NOR_SIZE - FMAN_SLOT_OFFSET) {
        for (i = 0; i < code_words; i++)
            ((uint32_t *)(void *)(g_nor + FMAN_SLOT_OFFSET +
                code_offset))[i] = 0xB0000000U + i;
    }
    if (calc + sizeof(uint32_t) <= NOR_SIZE - FMAN_SLOT_OFFSET)
        *(uint32_t *)(void *)(g_nor + FMAN_SLOT_OFFSET + calc) = 0;

    fw->header.length = (uint32_t)(calc + sizeof(uint32_t));
    return fw->header.length;
}

static void setup(void)
{
    memset(g_fman_iram, 0, sizeof(g_fman_iram));
    g_fman_idx = 0;
    g_fman_auto = 0;
    g_fman_ready = 0;
}

static void teardown(void)
{
}

/* A valid blob uploads and arms FMan. */
START_TEST(test_valid_blob)
{
    uint32_t base = (uint32_t)sizeof(struct qe_firmware);

    make_blob(base, 16, 1, 1);
    ck_assert_int_eq(hal_fman_init(), 0);
    ck_assert_uint_eq(get32(FMAN_IRAM_IREADY), FMAN_IRAM_READY);
    ck_assert_uint_eq(get32(FMAN_IRAM_IDATA), 0xB0000000U);
}
END_TEST

/* The pre-existing magic guard still holds. */
START_TEST(test_bad_magic)
{
    struct qe_firmware *fw;

    make_blob((uint32_t)sizeof(struct qe_firmware), 16, 1, 1);
    fw = slot();
    fw->header.magic[0] = 'X';
    ck_assert_int_eq(hal_fman_init(), -1);
}
END_TEST

START_TEST(test_bad_version)
{
    make_blob((uint32_t)sizeof(struct qe_firmware), 16, 7, 1);
    ck_assert_int_eq(hal_fman_init(), -1);
}
END_TEST

/* A container declaring more than one RISC must be accepted up to
 * QE_MAX_RISC, which this file defines as 4. The bound was a hand
 * written 2, so a 3-RISC container was rejected even though the length
 * formula (shared with the t10xx and p1021 siblings) handles it. Only
 * entry 0 carries code here; the others are zeroed, which the loader
 * skips via the !code_offset test. */
START_TEST(test_multi_risc_blob_accepted)
{
    make_blob(sizeof(struct qe_firmware) +
        2 * sizeof(struct qe_microcode), 8, 1, 3);

    ck_assert_int_eq(hal_fman_init(), 0);
}
END_TEST

/* count == 0 used to be accepted as a successful upload of nothing
 *; it must now be rejected. */
START_TEST(test_zero_count_rejected)
{
    make_blob(0, 0, 1, 0);
    ck_assert_int_eq(hal_fman_init(), -1);
    ck_assert_uint_eq(get32(FMAN_IRAM_IREADY), 0);
}
END_TEST

/* A self-consistent blob whose microcode offset lies past the declared
 * image must be rejected (the loader used to read from there
 * straight into FMan IRAM). */
START_TEST(test_mcode_offset_past_image_rejected)
{
    make_blob(0x100000, 16, 1, 1);
    ck_assert_int_eq(hal_fman_init(), -1);
    ck_assert_uint_eq(get32(FMAN_IRAM_IREADY), 0);
}
END_TEST

/* A self-consistent blob whose declared image extends past the end of
 * the NOR bank must be rejected. */
START_TEST(test_image_past_nor_extent_rejected)
{
    struct qe_firmware *fw;
    uint32_t base = (uint32_t)sizeof(struct qe_firmware);

    make_blob(base, 16, 1, 1);
    fw = slot();
    /* The code stays in the blob, but the declared length claims more
     * than the 0x380000 left after the slot. Self-consistency is kept:
     * the extra words are added to both the length and the count. The
     * claim lands in the guard slack after the bank, so the pre-fix
     * loader (no extent check) reads in-bounds and reports success. */
    fw->header.length = 0x390000; /* > 0x380000 extent */
    fw->microcode[0].count = (0x390000 - sizeof(uint32_t) -
        sizeof(struct qe_firmware)) / 4;

    ck_assert_int_eq(hal_fman_init(), -1);
    ck_assert_uint_eq(get32(FMAN_IRAM_IREADY), 0);
}
END_TEST

Suite *t2080_fman_loader_suite(void)
{
    Suite *s = suite_create("t2080-fman-loader");
    TCase *tc = tcase_create("t2080-fman-loader");

    tcase_add_checked_fixture(tc, setup, teardown);
    tcase_add_test(tc, test_valid_blob);
    tcase_add_test(tc, test_bad_magic);
    tcase_add_test(tc, test_bad_version);
    tcase_add_test(tc, test_multi_risc_blob_accepted);
    tcase_add_test(tc, test_zero_count_rejected);
    tcase_add_test(tc, test_mcode_offset_past_image_rejected);
    tcase_add_test(tc, test_image_past_nor_extent_rejected);
    suite_add_tcase(s, tc);

    return s;
}

int main(void)
{
    int fails;
    Suite *s = t2080_fman_loader_suite();
    SRunner *sr = srunner_create(s);

    srunner_run_all(sr, CK_NORMAL);
    fails = srunner_ntests_failed(sr);
    srunner_free(sr);

    return fails;
}
