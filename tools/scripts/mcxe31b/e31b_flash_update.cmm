;; e31b_flash_update.cmm
;;
;; Program the signed update image into the update partition of the NXP
;; MCXE31B (FRDM-MCXE31B).
;; No arguments: DO e31b_flash_update.cmm
;;
;; Connects with e31b_debug.cmm (reset and halt), programs the image with the
;; TRACE32 S32K3 flash algorithm, verifies it, resets the board to boot and
;; detaches the debugger.
;; Range erased and programmed: 0x005F0000--0x007CFFFF. Every other flash area
;; is left as is. The update is not triggered: use the test-app console
;; command "trigger" followed by "reboot".
;; The image must not reach the partition's last two sectors
;; (0x007CC000--0x007CFFFF): with NVM_FLASH_WRITEONCE wolfBoot keeps the update
;; state there and erases those sectors when the update is triggered, so the
;; image may be at most 0x1DC000 bytes.
;; The addresses match config/examples/mcxe31b.config. Update them here if the
;; partition layout is changed.
;; Output is logged to ~~/e31b_flash_update.log
;; The image is taken from the wolfBoot checkout this script is in.

; This script's directory, and the wolfBoot root three levels above it
&scriptdir=OS.PPD()
&basedir="&scriptdir\..\..\.."
&file="&basedir\test-app\image_v2_signed.bin"
&start=0x005F0000
&end=0x007CFFFF
; Partition size less the two trailer sectors
&maxsize=0x1DC000

DO "&scriptdir\e31b_debug.cmm"

AREA.OPEN A000 "~~/e31b_flash_update.log" /Create /NoFileCache
PRINT "e31b_flash_update.cmm " DATE.DATE() " " DATE.TIME()

IF !SYStem.Up()||STATE.RUN()
(
  PRINT %ERROR "not connected or CPU not halted, see ~~/e31b_debug.log"
  AREA.CLOSE A000
  ENDDO
)
IF !OS.FILE("&file")
(
  PRINT %ERROR "&file not found"
  AREA.CLOSE A000
  ENDDO
)
&size=OS.FILE.SIZE("&file")
IF &size>&maxsize
(
  PRINT %ERROR "&file does not fit before the update partition trailer (0x1DC000 bytes)"
  AREA.CLOSE A000
  ENDDO
)

; The flash algorithm runs from the CM7_0 DTCM, which is ECC protected and
; must be written before it is read
Data.Set SD:0x20000000++0xFFFF %Long 0

; S32K3 flash algorithm, code flash without the Secure BAF area
FLASH.RESet
FLASH.Create 1. 0x00400000--0x007D3FFF 0x2000 TARGET Long
FLASH.TARGET 0x20000000 0x20002000 0x1000 ~~/demo/arm/flash/long/s32k3x4.bin

; Sectors in range not covered by the file are erased
PRINT "programming &file (" FORMAT.Decimal(0.,&size) " bytes) at "+FORMAT.HEX(8.,&start)
FLASH.ReProgram &start--&end /Erase
Data.LOAD.Binary "&file" &start
FLASH.ReProgram OFF

Data.LOAD.Binary "&file" &start /DIFF
IF FOUND()
(
  PRINT %ERROR "verify FAILED"
  AREA.CLOSE A000
  ENDDO
)
PRINT "verify OK"
FLASH.RESet

; Reset and boot
AREA.CLOSE A000
DO "&scriptdir\e31b_debug.cmm"
AREA.OPEN A000 "~~/e31b_flash_update.log" /Append /NoFileCache
Go
; Detach: while attached, TRACE32 catches every reset at the reset vector, so
; the software reset that starts the update would leave the CPU halted
SYStem.Down
PRINT "done, board running, debugger detached"
AREA.CLOSE A000

ENDDO
