;; e31b_flash_factory_bin.cmm
;;
;; Program factory.bin (wolfBoot + signed test app) into the NXP MCXE31B
;; (FRDM-MCXE31B) and erase the update partition and swap sector.
;; No arguments: DO e31b_flash_factory_bin.cmm
;;
;; Connects with e31b_debug.cmm (reset and halt), programs the image with the
;; TRACE32 S32K3 flash algorithm, verifies it, resets the board to boot and
;; detaches the debugger.
;; Range erased and programmed: 0x00400000--0x007D1FFF (IVT + bootloader,
;; boot partition, update partition, swap sector). factory.bin must fit in the
;; bootloader + boot partition without the partition's last two sectors
;; (0x00400000--0x005EBFFF): with NVM_FLASH_WRITEONCE wolfBoot keeps the boot
;; state there and erases those sectors when it updates it. The data flash at
;; 0x10000000 and the Secure BAF area from 0x007D4000 are left as is.
;; The addresses match config/examples/mcxe31b.config. Update them here if the
;; partition layout is changed.
;;
;; factory.bin starts with the Image Vector Table that the boot ROM looks for
;; at 0x00400000. Without its marker the boot ROM does not start wolfBoot, so
;; the marker is checked in the file before anything is erased.
;; Output is logged to ~~/e31b_flash_factory_bin.log
;; factory.bin is taken from the wolfBoot checkout this script is in.

; This script's directory, and the wolfBoot root three levels above it
&scriptdir=OS.PPD()
&basedir="&scriptdir\..\..\.."
&file="&basedir\factory.bin"
&start=0x00400000
&end=0x007D1FFF
; factory.bin (bootloader + boot partition) must end before the boot
; partition's two trailer sectors (0x5EC000--0x5EFFFF)
&maxsize=0x1EC000
&ivt_marker=0x5AA55AA5

DO "&scriptdir\e31b_debug.cmm"

AREA.OPEN A000 "~~/e31b_flash_factory_bin.log" /Create /NoFileCache
PRINT "e31b_flash_factory_bin.cmm " DATE.DATE() " " DATE.TIME()

IF !SYStem.Up()||STATE.RUN()
(
  PRINT %ERROR "not connected or CPU not halted, see ~~/e31b_debug.log"
  AREA.CLOSE A000
  ENDDO
)
IF !OS.FILE("&file")
(
  PRINT %ERROR "&file not found"
  AREA.CLOSE A000
  ENDDO
)
&size=OS.FILE.SIZE("&file")
IF &size>&maxsize
(
  PRINT %ERROR "&file does not fit before the boot partition trailer (0x5EC000)"
  AREA.CLOSE A000
  ENDDO
)

; Refuse an image the boot ROM would not start
Data.LOAD.Binary "&file" VM:&start
IF Data.Long(VM:&start)!=&ivt_marker
(
  PRINT %ERROR "&file: no IVT marker at 0x00400000, not programming"
  AREA.CLOSE A000
  ENDDO
)

; The flash algorithm runs from the CM7_0 DTCM, which is ECC protected and
; must be written before it is read
Data.Set SD:0x20000000++0xFFFF %Long 0

; S32K3 flash algorithm, code flash without the Secure BAF area
FLASH.RESet
FLASH.Create 1. 0x00400000--0x007D3FFF 0x2000 TARGET Long
FLASH.TARGET 0x20000000 0x20002000 0x1000 ~~/demo/arm/flash/long/s32k3x4.bin

; Sectors in range not covered by the file are erased
PRINT "programming &file (" FORMAT.Decimal(0.,&size) " bytes) at "+FORMAT.HEX(8.,&start)
FLASH.ReProgram &start--&end /Erase
Data.LOAD.Binary "&file" &start
FLASH.ReProgram OFF

Data.LOAD.Binary "&file" &start /DIFF
IF FOUND()
(
  PRINT %ERROR "verify FAILED, not resetting"
  AREA.CLOSE A000
  ENDDO
)
PRINT "verify OK"
FLASH.RESet

; Reset and boot
AREA.CLOSE A000
DO "&scriptdir\e31b_debug.cmm"
AREA.OPEN A000 "~~/e31b_flash_factory_bin.log" /Append /NoFileCache
Go
; Detach: while attached, TRACE32 catches every reset at the reset vector, so
; a software reset (e.g. to start a firmware update) would leave the CPU halted
SYStem.Down
PRINT "done, board running, debugger detached"
AREA.CLOSE A000

ENDDO
