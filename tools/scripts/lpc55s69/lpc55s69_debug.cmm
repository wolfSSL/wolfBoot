;; lpc55s69_debug.cmm

&basedir="\\wsl.localhost\Ubuntu-22.04\home\tcook\wolf\wolfBoot"

RESet
SYStem.RESet
SYStem.CPU LPC55S69JBD100-CPU0
SYStem.CONFIG.DEBUGPORTTYPE SWD
IF COMBIPROBE()||UTRACE()
(
  SYStem.CONFIG.CONNECTOR MIPI20T
)
SYStem.Option DUALPORT ON
SYStem.MemAccess DAP
SYStem.JtagClock 10MHz
ITM.OFF
Trace.DISable
break.config.method program onchip
mode.hll

SYStem.Up

;; STOP in wolfBoot...
data.load "&basedir\wolfboot.elf" /nocode
symbol.sourcepath.TranslateSUBpath "\home\tcook\wolf\wolfBoot" "&basedir"
symbol.sourcepath.TranslateSUBpath "\home\tcook\wolf\NXP" "&basedir\..\NXP"
Register.Set PC isr_reset
Register.Set MSP END_STACK
break.set main /onchip /temporary
break.set do_boot /onchip /temporary
go

;; STOP in test-app...
;; UNCOMMENT the following:
;;WAIT !STATE.RUN()
;;data.load "&basedir\test-app\image.elf" /nocode
;;break.set main /onchip /temporary

go
