;; lpc55s69_flash_update.cmm
;; usage: DO lpc55s69_flash_update.cmm [update partition address]

PARAMETERS &update_addr
IF "&update_addr"==""
(
  &update_addr=0x40000
)

; wolfBoot root: three levels above this script
&basedir=OS.PPD()+"\..\..\.."

RESet
SYStem.RESet
SYStem.CPU LPC55S69JBD100-CPU0
SYStem.CONFIG.DEBUGPORTTYPE SWD
IF COMBIPROBE()||UTRACE()
(
  SYStem.CONFIG.CONNECTOR MIPI20T
)
SYStem.Option DUALPORT ON
SYStem.MemAccess DAP
SYStem.JtagClock 10MHz
ITM.OFF
Trace.DISable

SYStem.Up

DO ~~/demo/arm/flash/lpc55xx PREPAREONLY

; Change from 32KiB sector size to 512
flash.delete 1.
flash.create 1. 0x00000000--0x00097fff 0x200 TARGET Long

FLASH.ReProgram ALL
Data.LOAD.Binary "&basedir\test-app\image_v2_signed.bin" &update_addr
FLASH.ReProgram OFF

ENDDO
