;; lpc55s69_flash_update.cmm

&basedir="\\wsl.localhost\Ubuntu-22.04\home\tcook\wolf\wolfBoot"

RESet
SYStem.RESet
SYStem.CPU LPC55S69JBD100-CPU0
SYStem.CONFIG.DEBUGPORTTYPE SWD
IF COMBIPROBE()||UTRACE()
(
  SYStem.CONFIG.CONNECTOR MIPI20T
)
SYStem.Option DUALPORT ON
SYStem.MemAccess DAP
SYStem.JtagClock 10MHz
ITM.OFF
Trace.DISable

SYStem.Up

DO ~~/demo/arm/flash/lpc55xx PREPAREONLY


FLASH.ReProgram ALL
Data.LOAD.Binary "&basedir\test-app\image_v2_signed.bin" 0x18000
FLASH.ReProgram OFF

ENDDO
