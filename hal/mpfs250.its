## hal/mpfs250.its
```
/dts-v1/;

/ {
    description = "PolarFire SoC MPFS250T";
    #address-cells = <1>;

    images {
        kernel-1 {
            description = "Kernel Image";
            data = /incbin/("../kernel.bin");
            type = "kernel";
            arch = "riscv";
            os = "linux";
            compression = "none";
            load = <0x80200000>;
            entry = <0x80200000>;
            hash {
                algo = "sha256";
            };
        };
        fdt-1 {
            description = "Flattened Device Tree blob";
            data = /incbin/("mpfs.dtb");
            type = "flat_dt";
            arch = "riscv";
            compression = "none";
            load = <0x8a000000>;
            hash {
                algo = "sha256";
            };
        };
    };
    configurations {
        default = "conf@1";
        conf@1 {
            description = "PolarFire SoC MPFS250T";
            kernel = "kernel-1";
            fdt = "fdt-1";
            hash {
                algo = "sha256";
            };
        };
    };
};
```

## hal/versal.its
```
/dts-v1/;

/ {
    description = "Xilinx Versal VMK180 - wolfBoot Linux";
    #address-cells = <1>;

    images {
        kernel-1 {
            description = "Linux Kernel";
            data = /incbin/("../Image");
            type = "kernel";
            arch = "arm64";
            os = "linux";
            compression = "none";
            load = <0x00200000>;
            entry = <0x00200000>;
            hash-1 {
                algo = "sha256";
            };
        };
        fdt-1 {
            description = "Flattened Device Tree blob";
            data = /incbin/("../system-default.dtb");
            type = "flat_dt";
            arch = "arm64";
            compression = "none";
            load = <0x00001000>;
            hash-1 {
                algo = "sha256";
            };
        };
        /* FPGA bitstream sub-image (requires FPGA_BITSTREAM=1). Add the
         * "fpga = ..." reference to the configuration node below. The
         * bitstream must be a bootgen .bin staged to its load address.
         * NOTE: Versal PL config is a PDI loaded by the PLM (XilLoader
         * Load-PDI IPI) - the wolfBoot Versal hal_fpga_load is currently
         * a stub, so leave this disabled on Versal. On ZynqMP/Zynq-7000
         * this is the working convention.
         *
         * As emitted by mkimage the fpga node is usually gzip-compressed
         * and has no "load" property; set WOLFBOOT_LOAD_FPGA_ADDRESS to a
         * DDR staging address and build with GZIP=1.
         *
         * fpga-1 {
         *     description = "FPGA bitstream";
         *     data = /incbin/("../system.bit.bin.gz");
         *     type = "fpga";
         *     arch = "arm64";
         *     compression = "gzip";
         *     compatible = "u-boot,fpga-legacy";
         *     hash-1 {
         *         algo = "sha256";
         *     };
         * };
         */
    };
    configurations {
        default = "conf1";
        conf1 {
            description = "Linux kernel and FDT blob";
            kernel = "kernel-1";
            fdt = "fdt-1";
            /* fpga = "fpga-1"; */
            hash-1 {
                algo = "sha256";
            };
        };
    };
};
```

## tools/efi/br_ext_dir/configs/tiny_defconfig
```kconfig
BR2_x86_64=y
BR2_x86_corei7=y
# BR2_STRIP_strip is not set
# BR2_COMPILER_PARANOID_UNSAFE_PATH is not set
BR2_TOOLCHAIN_EXTERNAL=y
# BR2_TARGET_GENERIC_REMOUNT_ROOTFS_RW is not set
# BR2_ENABLE_LOCALE_PURGE is not set
BR2_LINUX_KERNEL=y
BR2_LINUX_KERNEL_USE_CUSTOM_CONFIG=y
BR2_LINUX_KERNEL_CUSTOM_CONFIG_FILE="$(BR2_EXTERNAL_TINY_PATH)/linux.config"
# BR2_PACKAGE_IFUPDOWN_SCRIPTS is not set
# BR2_PACKAGE_URANDOM_SCRIPTS is not set
BR2_TARGET_ROOTFS_INITRAMFS=y
# BR2_TARGET_ROOTFS_TAR is not set
```

## zephyr/Kconfig
```kconfig
# Kconfig
#
# Copyright (C) 2026 wolfSSL Inc.
#
# This file is part of wolfBoot.
#
# wolfBoot is free software; you can redistribute it and/or modify
# it under the terms of the GNU General Public License as published by
# the Free Software Foundation; either version 3 of the License, or
# (at your option) any later version.

menuconfig WOLFBOOT
	bool "wolfBoot integration"
	help
	  Enable wolfBoot integration helpers (PSA CMSE client glue, signing).

if WOLFBOOT

config WOLFBOOT_SIGN_TOOL
	string "Path to wolfBoot signing tool"
	default ""
	help
	  Optional override for the wolfBoot signing tool path. If empty, the
	  integration uses wolfBoot's tools/keytools/sign (C tool).

config WOLFBOOT_SIGNATURE_KEY_FILE
	string "wolfBoot signing key file"
	default ""
	help
	  Signing key used by the wolfBoot signing tool. If empty, the integration
	  falls back to CONFIG_MCUBOOT_SIGNATURE_KEY_FILE.

config WOLFBOOT_SIGN_ALG
	string "wolfBoot signing algorithm"
	default "ecc256"
	help
	  Signing algorithm passed to wolfBoot sign tool. Supported values depend
	  on wolfBoot (e.g. ecc256, ecc384, ed25519, rsa2048).

config WOLFBOOT_SIGN_HASH
	string "wolfBoot signing hash"
	default "sha256"
	help
	  Hash algorithm passed to wolfBoot sign tool (e.g. sha256, sha384, sha3).

config WOLFBOOT_SIGN_VERSION
	int "wolfBoot image version"
	default 1
	help
	  Integer version passed to wolfBoot sign tool. If left at the default,
	  the integration will attempt to derive a version from
	  CONFIG_MCUBOOT_IMGTOOL_SIGN_VERSION when possible.

endif # WOLFBOOT
```
