## hal/agilex5.its
```
/dts-v1/;

/ {
    description = "Altera Agilex 5 wolfBoot Linux payload";
    #address-cells = <1>;

    images {
        kernel-1 {
            description = "Linux kernel";
            data = /incbin/("../Image");
            type = "kernel";
            arch = "arm64";
            os = "linux";
            compression = "none";
            load = <0x82000000>;
            entry = <0x82000000>;
            hash-1 { algo = "sha256"; };
        };
        fdt-1 {
            description = "Agilex 5 device tree";
            data = /incbin/("../socfpga_agilex5_socdk.dtb");
            type = "flat_dt";
            arch = "arm64";
            compression = "none";
            load = <0x8f000000>;
            hash-1 { algo = "sha256"; };
        };
    };

    configurations {
        default = "conf-1";
        conf-1 {
            description = "Agilex 5 Linux";
            kernel = "kernel-1";
            fdt = "fdt-1";
            hash-1 { algo = "sha256"; };
        };
    };
};
```

## hal/cm4.its
```
/dts-v1/;
/*
 * hal/cm4.its - FIT template for booting Linux on the RPi CM4 via wolfBoot.
 * Kernel-only: the DTB is taken from the RPi firmware (fully patched: RAM size,
 * mini-UART clock, serial no.) - see hal/cm4.c hal_get_boot_dts(). Point the
 * incbin at the gzip kernel (Yocto fitImage-linux.bin) and build with:
 *   mkimage -f hal/cm4.its cm4-fitImage
 *   tools/keytools/sign --ecc384 --sha384 cm4-fitImage <key.der> <version>
 * Load/entry 0x10000000 matches config/examples/cm4_emmc_linux.config (and GCX
 * UBOOT_LOADADDRESS). Copyright (C) 2026 wolfSSL Inc.  GPLv3.
 */
/*
 * The hash-1 { algo = "sha256"; } nodes below are informational only: mkimage
 * populates their `value`, but wolfBoot does not re-verify per-image hashes here.
 * Authentication of the whole FIT comes from the outer wolfBoot signature; the
 * FIT hashes are best-effort defense-in-depth, not an enforced integrity check.
 */
/ {
    description = "wolfBoot CM4 (BCM2711) Linux";
    #address-cells = <1>;
    images {
        kernel-1 {
            description = "Linux kernel (arm64, gzip)";
            data = /incbin/("../Image.gz");
            type = "kernel"; arch = "arm64"; os = "linux"; compression = "gzip";
            load = <0x10000000>; entry = <0x10000000>;
            hash-1 { algo = "sha256"; };
        };
    };
    configurations { default = "conf1"; conf1 { kernel = "kernel-1"; hash-1 { algo = "sha256"; }; }; };
};
```

## hal/s32g2.its
```
/dts-v1/;
/*
 * hal/s32g2.its - FIT for the S32G2: kernel plus the
 * device tree, both under the wolfBoot signature. No earlier loader patches a
 * DTB here, so wolfBoot adds /memory and the spin-table release addresses.
 *   tools/scripts/s32g2/s32g2-mkfit.sh <Image> [version] [key] <dtb>
 * Copyright (C) 2026 wolfSSL Inc.  GPLv3.
 */
/ {
    description = "wolfBoot S32G2 (S32G274A) Linux + DTB";
    #address-cells = <1>;
    images {
        kernel-1 {
            description = "Linux kernel (arm64, gzip)";
            data = /incbin/("../Image.gz");
            type = "kernel"; arch = "arm64"; os = "linux"; compression = "gzip";
            load = <0x84080000>; entry = <0x84080000>;
            hash-1 { algo = "sha256"; };
        };
        fdt-1 {
            description = "Flattened device tree";
            data = /incbin/("../s32g2.dtb");
            type = "flat_dt"; arch = "arm64"; compression = "none";
            hash-1 { algo = "sha256"; };
        };
    };
    configurations { default = "conf1"; conf1 { kernel = "kernel-1"; fdt = "fdt-1"; hash-1 { algo = "sha256"; }; }; };
};
```
